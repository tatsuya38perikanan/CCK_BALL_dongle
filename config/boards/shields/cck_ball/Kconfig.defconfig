## config/boards/shields/cck_ball/Kconfig.defconfig
```kconfig
if SHIELD_CCK_BALL_DONGLE

config ZMK_KEYBOARD_NAME
	default "WK CCK BALL"

config ZMK_SPLIT_BLE_ROLE_CENTRAL
	default y

config ZMK_SPLIT_BLE_CENTRAL_PERIPHERALS
	default 2

if ZMK_DISPLAY

config I2C
	default y

config SSD1306
	default y

endif # ZMK_DISPLAY

endif # SHIELD_CCK_BALL_DONGLE

if SHIELD_CCK_BALL_LEFT || SHIELD_CCK_BALL_RIGHT || SHIELD_CCK_BALL_DONGLE

config ZMK_SPLIT
	default y

endif
```

## config/west.yml
```yaml
manifest:
  remotes:
    - name: zmkfirmware
      url-base: https://github.com/imhy123
    - name: tatsuya38perikanan
      url-base: https://github.com/tatsuya38perikanan
    - name: englmaxi
      url-base: https://github.com/englmaxi
  projects:
    - name: zmk
      remote: zmkfirmware
      revision: v0.3-branch
      import: app/west.yml
    - name: zmk-pmw3610-driver
      remote: tatsuya38perikanan
      revision: main
    - name: zmk-dongle-display
      remote: englmaxi
      revision: v0.3
  self:
    path: config
```
